/ {
    aliases {
            led0 = &red_led;
            led1 = &green_led;
            sw0 = &user_button;
            volt-sensor1 = &vbat;
            uart7 = &uart7;
        };
};

&uart7 {
	pinctrl-0 = <&uart7_tx_pf7 &uart7_rx_pf6>;
	pinctrl-names = "default";
	current-speed = <115200>;
	status = "okay";
};

&mac {
	pinctrl-0 = <&eth_rxd0_pc4
		     &eth_rxd1_pc5
		     &eth_ref_clk_pa1
		     &eth_crs_dv_pa7
		     &eth_tx_en_pb11
		     &eth_txd0_pb12
		     &eth_txd1_pb13>;
	pinctrl-names = "default";
	status = "okay";
};